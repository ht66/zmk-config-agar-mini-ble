## config/dts/bindings/kp2.yaml
```yaml
# Copyright (c) 2025 The ZMK Contributors
# SPDX-License-Identifier: MIT

description: Enhanced key press with dynamic toggle

compatible: "zmk,behavior-kp2"

properties:
  "#binding-cells":
    type: int
    required: true
    const: 2

binding-cells:
  - param1
  - param2
```

## config/dts/bindings/mv.yaml
```yaml
# Copyright (c) 2025 The ZMK Contributors
# SPDX-License-Identifier: MIT

description: Mouse move with variable speed

compatible: "zmk,behavior-mv"

properties:
  "#binding-cells":
    type: int
    required: true
    const: 2

binding-cells:
  - param1
  - param2
```

## config/dts/bindings/toggle.yaml
```yaml
# Copyright (c) 2025 The ZMK Contributors
# SPDX-License-Identifier: MIT

description: Toggle switch for kp2 behavior

compatible: "zmk,behavior-toggle"

properties:
  "#binding-cells":
    type: int
    required: true
    const: 0
```

## config/dts/bindings/zmk,behavior-dynamic-mouse-move.yaml
```yaml
# Copyright (c) 2025 The ZMK Contributors
# SPDX-License-Identifier: MIT

description: Dynamic dual-speed mouse movement behavior

compatible: "zmk,behavior-dynamic-mouse-move"

properties:
  x-input-code:
    type: int
    required: true
  y-input-code:
    type: int
    required: true
  trigger-period-ms:
    type: int
    default: 8
  delay-ms:
    type: int
  time-to-max-speed-ms:
    type: int
    required: true
  acceleration-exponent:
    type: int
    default: 1

binding-cells:
  - param1
  - param2
```

## config/dts/bindings/zmk,behavior-dynamic-move.yaml
```yaml
compatible: "zmk,behavior-dynamic-move"
description: "zmk,behavior-dynamic-move"
include: two_param.yaml
properties:
  x-input-code:
    type: int
    required: true
  y-input-code:
    type: int
    required: true
  trigger-period-ms:
    type: int
    default: 16
  delay-ms:
    type: int
  time-to-max-speed-ms:
    type: int
    required: true
  acceleration-exponent:
    type: int
    default: 1

binding-cells:
  - param1
  - param2
```

## config/dts/bindings/zmk,behavior-speed-change.yaml
```yaml
# Copyright (c) 2025 The ZMK Contributors
# SPDX-License-Identifier: MIT

description: Toggle speed of a dynamic mouse move behavior

compatible: "zmk,behavior-speed-change"

include: base.yaml

properties:
  target:
    type: phandle
    required: true
    description: Reference to the dynamic mouse move device to control
```

## config/dts/bindings/zmk,behavior-speed-modifier.yaml
```yaml
compatible: "zmk,behavior-speed-modifier"
description: "Hold to reduce mouse speed of a dynamic-mouse-move instance"
properties:
  target:
    type: phandle
    required: true
    description: "Phandle to dynamic_mouse_move node"
  slow_factor:
    type: int
    required: true
    description: "Speed multiplier while key is held"
  "#binding-cells":
    type: int
    const: 0
```

## config/dts/bindings/zmk,behavior-speed-switch.yaml
```yaml
description: "zmk,behavior-speed-switch"
compatible: "zmk,behavior-speed-switch"

properties:
  target:
    type: phandle
    required: true
```

## config/dts/bindings/zmk,behavior-two-axis-move.yaml
```yaml
description: two axis move
compatible: "zmk,behavior-two-axis-move"
properties:
  x-input-code:
    type: int
    required: true
  y-input-code:
    type: int
    required: true
  trigger-period-ms:
    type: int
    default: 16
  delay-ms:
    type: int
  time-to-max-speed-ms:
    type: int
    required: true
  acceleration-exponent:
    type: int
    default: 1
  "#binding-cells":
    type: int
    required: true
    const: 2
binding-cells:
  - param1
  - param2
```
